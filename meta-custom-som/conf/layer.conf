## meta-custom-som/conf/layer.conf
```bitbake
# Layer config for the custom SoM BSP
BBPATH .= ":${LAYERDIR}"
BBFILES += "${LAYERDIR}/recipes-*/*/*.bb ${LAYERDIR}/recipes-*/*/*.bbappend"

BBFILE_COLLECTIONS += "custom-som"
BBFILE_PATTERN_custom-som = "^${LAYERDIR}/"
BBFILE_PRIORITY_custom-som = "10"

LAYERDEPENDS_custom-som = "core"
LAYERSERIES_COMPAT_custom-som = "scarthgap"
```
